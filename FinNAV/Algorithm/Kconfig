## FinNAV/Algorithm/Kconfig
```kconfig
menu "Algorithm Configuration"

## Basic Algorithm Sets ##
config LIBROV_ENABLE_BAS
	bool "Enable Basic Algorithm API"
	default y

config LIBROV_ENABLE_VEC_2
	bool "Enable 2D-Vector API"
	depends on LIBROV_ENABLE_BAS
	default n

config LIBROV_ENABLE_VEC_3
	bool "Enable 3D-Vector API"
	depends on LIBROV_ENABLE_BAS
	default n

## MatROV Lib ##
menuconfig LIBROV_ENABLE_MATROV
	bool "Enable MatROV Library"
	depends on LIBROV_ENABLE_BAS
	default n
	help
		MatROV is an embedded Matrix Algorithm Library, part of FinNAV

config MATROV_ENABLE_POINT
	bool "Enable Point Operations API"
	depends on LIBROV_ENABLE_MATROV
	default n

config MATROV_ENABLE_VECTOR
	bool "Enable Vector Operations API"
	depends on LIBROV_ENABLE_MATROV
	default n

config MATROV_ENABLE_MATRIX
	bool "Enable Matrix Operations API"
	depends on LIBROV_ENABLE_MATROV
	default n

config MATROV_STATIC_MEM
	bool "Enable Static Memory Management for Matrix API"
	depends on LIBROV_ENABLE_MATROV
	default n

## Complex Calculation ##
config LIBROV_ENABLE_COMPLEX
	bool "Enable Complex Calculation API"
	depends on LIBROV_ENABLE_BAS
	default n

## Quaternion ##
config LIBROV_ENABLE_QUATERNION
	bool "Enable Quaternion Calculation API"
	depends on LIBROV_ENABLE_BAS
	default n

## Deadreckon ##
config LIBROV_ENABLE_DEADRECKON
	bool "Enable Deadreckon API"
	default n

## Integration ##
config LIBROV_ENABLE_INTEGRATION
	bool "Enable Integration API"
	default n

## Encoder/Decoder ##
config LIBROV_ENABLE_SUMCHECK
	bool "Enable Sum-Check Encoder/Decoder"
	default n

choice
	prompt "Enable CRC8 Encoder/Decoder"
	default LIBROV_DISABLE_CRC8

	config LIBROV_DISABLE_CRC8
		bool "Disable Hardware CRC8"
	config LIBROV_ENABLE_CRC8_SOFTWARE
		bool "Enable Software CRC8"
	config LIBROV_ENABLE_CRC8_HARDWARE
		bool "Enable Hardware CRC8"
endchoice

config LIBROV_ENABLE_PARITY
	bool "Enable Parity-Check Encoder/Decoder"
	default n

config LIBROV_ENABLE_ODD
	bool "Enable Odd-Check Encoder/Decoder"
	default n

## PID ##
menuconfig LIBROV_ENABLE_PID
	bool "Enable PID Algorithm"
	default n

if LIBROV_ENABLE_PID
config PID_IN_PD_MODE
	bool "Enable PD Controller"
	default y
	
config ENABLE_INCRETOR
	bool "Enable Incretor-Mode PID"
	default n
	
config PID_EXTENSION_ORBIT
	bool "Enable Orbit Mode Remap Extension for PID"
	default n
	
config PID_EXTENSION_LPF
	bool "Enable Low-Pass-Filter Extension for PID"
	default n

config FIXED_PID_PARAMETER
	bool "fixed Kp, Ki, Kd Initial parameters"
	default n

comment "all follow parameters are multiplied by 1000 as result"
	depends on FIXED_PID_PARAMETER

config PID_Kp
	int "Orbit Kp parameter"
	depends on FIXED_PID_PARAMETER
	default -1472

config PID_Ki
	int "Orbit Ki parameter"
	depends on FIXED_PID_PARAMETER
	default -500

config PID_Kd
	int "Orbit Kd parameter"
	depends on FIXED_PID_PARAMETER
	default -300

config PID_FF
	int "FeedForward parameter"
	depends on FIXED_PID_PARAMETER
	default 1000

config PID_ERROR_MIN
	int "Error Limit Bottom Value parameter"
	depends on FIXED_PID_PARAMETER
	default -1000

config PID_ERROR_MAX
	int "Error Limit Top Value parameter"
	depends on FIXED_PID_PARAMETER
	default 1000

config PID_INT_SEPERATION
	int "Integral Seperation parameter"
	depends on FIXED_PID_PARAMETER
	default -1472

config PID_INT_DECAY
	int "Integral Decay parameter"
	depends on FIXED_PID_PARAMETER
	default 1000

config PID_INT_MIN
	int "Integral Limit Bottom Value parameter"
	depends on FIXED_PID_PARAMETER
	default -3000

config PID_INT_MAX
	int "Integral Limit Top Value parameter"
	depends on FIXED_PID_PARAMETER
	default 3000

config PID_DIFF_MIN
	int "Difference Limit Bottom Value parameter"
	depends on FIXED_PID_PARAMETER
	default -500

config PID_DIFF_MAX
	int "Difference Limit Top Value parameter"
	depends on FIXED_PID_PARAMETER
	default 500

config PID_OUTPUT_MIN
	int "Output Limit Bottom Value parameter"
	depends on FIXED_PID_PARAMETER
	default -5000

config PID_OUTPUT_MAX
	int "Output Limit Top Value parameter"
	depends on FIXED_PID_PARAMETER
	default -5000
endif

## LADRC Control ##
config LIBROV_ENABLE_LADRC
	bool "Enable Linear ADRC Algorithm"
	default n

## LQR Control ##
config LIBROV_ENABLE_LQR
	bool "Enable LQR Algorithm"
	default n

## Filters ##
config LIBROV_ENABLE_LPF
	bool "Enable First-order Low-Pass Filter Algorithm"
	default n

config LIBROV_ENABLE_SMF
	bool "Enable Sliding Mean Filter Algorithm"
	default n

config MEANFILTER_SIZE
	int "Sliding Mean Filter Box-size parameter"
	depends on LIBROV_ENABLE_SMF
	default 10

config LIBROV_ENABLE_CF
	bool "Enable Complementary Filter Algorithm"
	default n

## Kalman Filter ##
config LIBROV_ENABLE_KALMAN_FILTER
	bool "Use Kalman Filter Algorithm"
	default n

config LIBROV_KALMAN_LINEAR
	bool "Enable One-Order Kalman Filter"
	depends on LIBROV_ENABLE_KALMAN_FILTER
	default n

config LIBROV_KALMAN_MATRIX
	bool "Enable Higher-Order Kalman Filter"
	depends on LIBROV_ENABLE_KALMAN_FILTER
	default n

config LIBROV_KALMAN_EKF
	bool "Enable Extented Kalman Filter"
	depends on LIBROV_ENABLE_KALMAN_FILTER
	default n

## Miscellaneous ##
menuconfig FIXED_MISC_PARAMETER
	bool "fixed Misc-Algorithm parameters"
	default n
if FIXED_MISC_PARAMETER
comment "TODO"
endif

endmenu
```

## FinNAV/Base/Kconfig
```kconfig
menu "Basic Components Configuration"
	config LIBROV_USE_ASSERT
		bool "Use Assert Function"
		default y

	config LIBROV_USE_PANIC
		bool "Use Forced Pancic Function"
		default y

	config LIBROV_PRINT_ALL_LOGS
		bool "Print All Information Logs"
		default n

	config LIBROV_USE_STDBOOL
		bool "Use <stdbool.h> as Standard Boolean"
		default y

	choice
		prompt "Select Cabin Function"
		default LIBROV_STANDALONE

		config LIBROV_POWER_CABIN
			bool "Power Cabin"
		config LIBROV_CTRL_CABIN
			bool "Control Cabin"
		config LIBROV_COMM_CABIN
			bool "Communication Cabin"
		config LIBROV_MAIN_CABIN
			bool "Main Cabin"
		config LIBROV_STANDALONE
			bool "Standalone Project with FinNAV"
	endchoice
endmenu


menu "Thruster Configuration"
	choice
		prompt "The Number of Horizental Thrusters"
		depends on !LIBROV_STANDALONE
		default AXIS_4_HORIZENTAL
		help
			Number of horizental thrusters, according to your UUV

		config AXIS_2_HORIZENTAL
			bool "2-axis horizental thruster"
		config AXIS_4_HORIZENTAL
			bool "4-axis horizental thruster"
	endchoice

	choice
		prompt "The Number of Vertical Thrusters"
		depends on !LIBROV_STANDALONE
		default AXIS_2_VERTICAL
		help
			Number of vertical thrusters, according to your UUV

		config AXIS_1_VERTICAL
			bool "1-axis vertical thruster"
		config AXIS_2_VERTICAL
			bool "2-axis vertical thruster"
		config AXIS_3_VERTICAL
			bool "3-axis vertical thruster"
		config AXIS_4_VERTICAL
			bool "4-axis vertical thruster"
	endchoice

	config PWM_DEFAULT_VALUE
		int "The PWM value for Thruster Middle Position(Default Value)"
		range 0 65535
		depends on !LIBROV_STANDALONE
		default 1480
		help
			Default PWM value for your ESC of thruster.

endmenu
```

## FinNAV/BasicCtrl/Kconfig
```kconfig
menu "Route Configuration"

menu "Protocol Configuration"
## Link Protocol Selection ##
choice
	prompt "Use RovLink or Lagency"
	default LIBROV_USE_ROVLINK

	config LIBROV_USE_ROVLINK
		bool "Use RovLink for control and communication"
	config USE_LAGENCY
		bool "Support Lagency DataFrames"
	config USE_USER_PROTOCOL
		bool "User defined Protocol"
endchoice

## LIBROV_USE_ROVLINK ##
choice
	prompt "Identify Algorithm"
	default ROVLINK_IDENTIFY_ALG_NO

	config ROVLINK_IDENTIFY_ALG_CRC
		bool "CRC Algorithm"
		depends on LIBROV_ENABLE_CRC8_SOFTWARE || LIBROV_ENABLE_CRC8_HARDWARE
		help
			Review Algorithm-Enable CRC8 Encoder/Decoder to check use CRC in which way
	config ROVLINK_IDENTIFY_ALG_SUM
		bool "Sum-check Algorithm"
		depends on LIBROV_ENABLE_SUMCHECK
	config ROVLINK_IDENTIFY_ALG_PARITY
		bool "Parity-check Algorithm"
		depends on LIBROV_ENABLE_PARITY
	config ROVLINK_IDENTIFY_ALG_ODD
		bool "Odd-check Algorithm"
		depends on LIBROV_ENABLE_ODD
	config ROVLINK_IDENTIFY_ALG_NO
		bool "Not Use Check Algorithm"
endchoice

choice
	prompt "Select Software CRC or Hardware CRC"
	depends on ROVLINK_IDENTIFY_ALG_CRC
	default ROVLINK_CRC_SOFTWARE_BW

	config ROVLINK_CRC_SOFTWARE_LUT
		bool "Software CRC in Look-Up-Table"
	config ROVLINK_CRC_SOFTWARE_BW
		bool "Software CRC in Bit-Wise"
	config ROVLINK_CRC_HARDWARE
		bool "Hardware CRC"
endchoice

config ROVLINK_ENABLE_OTA
	bool "Enable Rovlink OTA Function"
	depends on LIBROV_USE_ROVLINK
	default n

config ROVLINK_ENABLE_PASSBY
	bool "Enable Passby-Message UART"
	depends on LIBROV_USE_ROVLINK
	default n

## USE_LAGENCY ##
config LAGENCY_COMMAND_LENGTH
	int "length of Command Frame"
	depends on USE_LAGENCY
	default 23

config LAGENCY_REPORT_LENGTH
	int "length of Lagency Report Frame"
	depends on USE_LAGENCY
	default 37

endmenu



endmenu
```

## FinNAV/Display/Kconfig
```kconfig
menu "Console and Display(Functional IO) Configuration"

	config LIBROV_ENABLE_OSD
		bool "Enable OSD Video Controller"
		default n

	choice
        prompt "Select an OSD Controller"
		depends on LIBROV_ENABLE_OSD
        default QL50

        config QL50
            bool "Use QL50 OSD Board"
        config AT7456
            bool "Use AT7456 OSD Chip"
        config MAX7456
            bool "Use MAX7456 OSD Chip"
    endchoice

	choice
        prompt "Select OSD Interface device type"
		depends on LIBROV_ENABLE_OSD
        default OSD_DEVICE_UART

        config OSD_DEVICE_UART
            bool "Use UART"
        config OSD_DEVICE_I2C
            bool "Use I2C"
        config OSD_DEVICE_SPI
            bool "Use SPI"
    endchoice

    config OSD_DEV_NUMBER
        int "OSD Device Number"
        range 1 20
		depends on LIBROV_ENABLE_OSD
        default 4

endmenu
```

## FinNAV/Driver/Kconfig
```kconfig
menuconfig LIBROV_USE_DRIVER
	bool "Enable FinNAV Peripheral Driver"
	default n
if LIBROV_USE_DRIVER
	config BSP_CONFIG_FILE
		string "BSP Configuration Header File Name"
		default "bsp_stm32f407xx.h"
	
	menuconfig LIBROV_ENABLE_DRIVER_GPIO
		bool "Enable GPIO Driver"
		default y
		if LIBROV_ENABLE_DRIVER_GPIO
			config GPIO_DEV_MAX_NUM
				int "Max number of GPIO Device Object"
				range 1 16
				default 2
		endif #LIBROV_ENABLE_DRIVER_GPIO

	menuconfig LIBROV_ENABLE_DRIVER_UART
		bool "Enable UART Driver"
		default y
		if LIBROV_ENABLE_DRIVER_UART
			config UART_DEV_MAX_NUM
				int "Max number of UART Device Object"
				range 1 20
				default 2
			
			choice UART_DEV_TRANSMIT_MODE
				prompt "UART Transmit Mode"
				depends on LIBROV_ENABLE_DRIVER_UART
				default UART_DEV_TX_USE_POLLING
		
				config UART_DEV_TX_USE_POLLING
					bool "Enable Polling Transmit"
				config UART_DEV_TX_USE_INT
					bool "Enable Interrupt Transmit"
				config UART_DEV_TX_USE_DMA
					bool "Enable DMA Transmit"
					depends on LIBROV_ENABLE_DRIVER_DMA
			endchoice
		
			choice UART_DEV_RECEIVE_MODE
				prompt "UART Receive Mode"
				depends on LIBROV_ENABLE_DRIVER_UART
				default UART_DEV_RX_USE_POLLING
		
				config UART_DEV_RX_USE_POLLING
					bool "Enable Polling Receive"
				config UART_DEV_RX_USE_INT
					bool "Enable Interrupt Receive"
				config UART_DEV_RX_USE_DMA
					bool "Enable DMA Receive"
					depends on LIBROV_ENABLE_DRIVER_DMA
			endchoice
		endif #LIBROV_ENABLE_DRIVER_UART

	menuconfig LIBROV_ENABLE_DRIVER_DMA
		bool "Enable DMA Driver"
		default n

	menuconfig LIBROV_ENABLE_DRIVER_PWM
		bool "Enable PWM Driver"
		default n

	menuconfig LIBROV_ENABLE_DRIVER_HWTIM
		bool "Enable Hardware Timer Driver"
		default n

	menuconfig LIBROV_ENABLE_DRIVER_RTC
		bool "Enable RTC Driver"
		default n

	menuconfig LIBROV_ENABLE_DRIVER_WDG
		bool "Enable WatchDog Timer Driver"
		default n

	menuconfig LIBROV_ENABLE_DRIVER_I2C
		bool "Enable Hardware I2C Driver"
		default n

	menuconfig LIBROV_ENABLE_DRIVER_SPI
		bool "Enable SPI Driver"
		default n

	menuconfig LIBROV_ENABLE_DRIVER_I2C_SOFT
		bool "Enable Software I2C Driver"
		depends on LIBROV_ENABLE_DRIVER_GPIO
		default n

	menuconfig LIBROV_ENABLE_DRIVER_CAN
		bool "Enable Lagency CAN Driver"
		default n

	menuconfig LIBROV_ENABLE_DRIVER_CANFD
		bool "Enable CANFD Driver"
		default n

	menuconfig LIBROV_ENABLE_DRIVER_ADC
		bool "Enable ADC Driver"
		default n

	menuconfig LIBROV_ENABLE_DRIVER_DAC
		bool "Enable DAC Driver"
		default n

	menuconfig LIBROV_ENABLE_DRIVER_ONCHIP_FLASH
		bool "Enable on-chip Flash Driver"
		default n

	menuconfig LIBROV_ENABLE_DRIVER_SDIO
		bool "Enable SDIO Driver"
		default n

	menuconfig LIBROV_ENABLE_DRIVER_PARALLEL
		bool "Enable Parallel Interface Driver"
		default n

	menuconfig LIBROV_ENABLE_DRIVER_ETH
		bool "Enable Ethernet Interface(RMII) Driver"
		default n

	menuconfig LIBROV_ENABLE_DRIVER_DSP
		bool "Enable DSP(Digital Signal Processor) Driver"
		depends on CONFIG_SOC_USE_DSP
		default n

	menuconfig LIBROV_ENABLE_DRIVER_FPGA
		bool "Enable Customized FPGA IP Driver"
		default n

	## RovLink Device Configuration ##
	menuconfig ROVLINK_DEVICE_DRIVER
		bool "RovLink Standard Protocol Device Driver"
		depends on LIBROV_USE_ROVLINK
		default y
		if ROVLINK_DEVICE_DRIVER
			choice
				prompt "Select LinkCOM device type"
				default LINKCOM_DEVICE_UART
			
				config LINKCOM_DEVICE_UART
					bool "Use TTL/RS232/RS485"
				config LINKCOM_DEVICE_CAN
					bool "Use CAN"
				config LINKCOM_DEVICE_ETH
					bool "Use ETH"
			endchoice
				
			config LINKCOM_DEV_NUMBER
				int "LinkCOM UART Device Number"
				range 1 20
				default 2
			
			choice
				prompt "Select PassCOM device type"
				depends on ROVLINK_ENABLE_PASSBY
				default PASSCOM_DEVICE_UART
			
				config PASSCOM_DEVICE_UART
					bool "Use TTL/RS232/RS485"
				config PASSCOM_DEVICE_CAN
					bool "Use CAN"
				config PASSCOM_DEVICE_ETH
					bool "Use ETH"
			endchoice
				
			config PASSCOM_DEV_NUMBER
				int "PassCOM Device Number"
				range 1 20
				depends on ROVLINK_ENABLE_PASSBY
				default 3
		endif #ROVLINK_DEVICE_DRIVER
endif #LIBROV_USE_DRIVER
```

## FinNAV/Kconfig.main
```kconfig
## Basic Configuration ##
source "$(FINNAV_LIBROV_DIR)/Base/Kconfig"

## Algorithm Configuration ##
source "$(FINNAV_LIBROV_DIR)/Algorithm/Kconfig"

## Thread Configuration ##
source "$(FINNAV_LIBROV_DIR)/Thread/Kconfig"

## Runtime Configuration ##
source "$(FINNAV_LIBROV_DIR)/Runtime/Kconfig"

## Console Configuration ##
source "$(FINNAV_LIBROV_DIR)/Display/Kconfig"

## Route Configuration ##
source "$(FINNAV_LIBROV_DIR)/BasicCtrl/Kconfig"

## Sensor Configuration ##
source "$(FINNAV_LIBROV_DIR)/Sensor/Kconfig"

## Driver Configuration ##
source "$(FINNAV_LIBROV_DIR)/Driver/Kconfig"
```
