## FinNAV/Runtime/Kconfig
```kconfig
menu "Runtime Component Configuration"

	config LIBROV_USE_STDIO
		bool "Use <stdio.h> to handle IO"
		default n
	
	config LIBROV_USE_KPRINT
		bool "Use rov_kprintf Function"
		default n

	config LIBROV_USE_TRACE
		bool "Use Trace Support"
		default n

	config LIBROV_ENABLE_MEMCTRL
		bool "Manage memory in FinNAV API"
		default n
		help
			FinNAV use `malloc` and `free` functions in <stdlib.h> to
			memory heap memory as default.
			Enable this entry to use INDEPENDENT `malloc` and `free` 
			in FinNAV, which can be implement by RTOS or LibROV

	config LIBROV_HANDLE_INTERRUPT
		bool "Handle Interrupt by FinNAV"
		depends on LIBROV_USE_DRIVER
		default n


		
choice
	prompt "Select Console Device"
	default LIBROV_CONSOLE_UART

	config LIBROV_CONSOLE_UART
		bool "UART"
	config LIBROV_CONSOLE_CAN
		bool "CAN"
	config LIBROV_CONSOLE_OSD
		bool "OSD"
endchoice

config CONSOLE_DEV_NUMBER
	int "Console UART Device Number"
	range 0 20
	depends on LIBROV_CONSOLE_UART
	default 0
	
config CONSOLE_DEV_BAUDRATE
	int "Console UART Device Baudrate"
	range 4800 921600
	depends on LIBROV_CONSOLE_UART
	default 115200

config DEBUG_UART_SIZE
	int "Max Size of Debug UART buffer in bytes"
	depends on LIBROV_CONSOLE_UART
	default 128




config LIBROV_ENABLE_RLOG
	bool "Enable rlog Component"
	default n

config RLOG_MAX_COMMITOR
	int "Max Number of commitors in all RLOG-List"
	depends on LIBROV_ENABLE_RLOG
	default 4

config RLOG_MAX_LENGTH
	int "Max Data Length(Bytes) of Debug Messages"
	depends on LIBROV_ENABLE_RLOG
	default 64

endmenu
```

## FinNAV/Sensor/Kconfig
```kconfig
menuconfig LIBROV_USE_SENSOR
	bool "Enable FinNAV Sensor Driver"
	default n
if LIBROV_USE_SENSOR

menuconfig LIBROV_SENSOR_IMU
	bool "IMU Sensor"
	default n
if LIBROV_SENSOR_IMU
	choice
		prompt "Select Main IMU Sensor"
		default SENSOR_IMU_MPU6500_MAIN

		config SENSOR_IMU_MPU6500_MAIN
			bool "Use MPU6500"
		config SENSOR_IMU_MPU6050_MAIN
			bool "Use MPU6050"
		config SENSOR_IMU_QMI8658_MAIN
			bool "Use QMI8658"
		config SENSOR_IMU_BMI088_MAIN
			bool "Use BMI088"
		config SENSOR_IMU_ICM42688_MAIN
			bool "Use ICM42688"
	endchoice

	choice
		prompt "Select Auxiliary IMU Sensor"
		default SENSOR_IMU_MPU6500_AUX

		config SENSOR_IMU_MPU6500_AUX
			bool "Use MPU6500"
		config SENSOR_IMU_MPU6050_AUX
			bool "Use MPU6050"
		config SENSOR_IMU_QMI8658_AUX
			bool "Use QMI8658"
		config SENSOR_IMU_BMI088_AUX
			bool "Use BMI088"
		config SENSOR_IMU_ICM42688_AUX
			bool "Use ICM42688"
	endchoice

	choice
		prompt "Select Main IMU Interface device type"
		default MAIN_IMU_DEVICE_UART

		config MAIN_IMU_DEVICE_UART
			bool "Use UART"
		config MAIN_IMU_DEVICE_I2C
			bool "Use I2C"
		config MAIN_IMU_DEVICE_SPI
			bool "Use SPI"
		config MAIN_IMU_DEVICE_ADC
			bool "Use ADC for raw data"
	endchoice

	choice
		prompt "Select Auxiliary IMU Interface device type"
		default AUX_IMU_DEVICE_UART

		config AUX_IMU_DEVICE_UART
			bool "Use UART"
		config AUX_IMU_DEVICE_I2C
			bool "Use I2C"
		config AUX_IMU_DEVICE_SPI
			bool "Use SPI"
		config AUX_IMU_DEVICE_ADC
			bool "Use ADC for raw data"
	endchoice

	config MAIN_IMU_DEV_NUMBER
		int "Main IMU Device Number"
		range 1 20
		default 7

	config AUX_IMU_DEV_NUMBER
		int "Auxiliary IMU Device Number"
		range 1 20
		default 8
endif

menuconfig SENSOR_AHRS
	bool "AHRS Sensor"
	default n
if SENSOR_AHRS
	choice
		prompt "Select an AHRS Sensor"
		default SENSOR_AHRS_WT931

		config SENSOR_AHRS_WT931
			bool "Use WT931"
		config SENSOR_AHRS_BNO055
			bool "Use BNO055"
		config SENSOR_AHRS_MPU9250
			bool "Use MPU9250"
		config SENSOR_AHRS_MTI630
			bool "Use MTI630"
	endchoice

	choice
		prompt "Select AHRS Interface device type"
		default AHRS_DEVICE_UART

		config AHRS_DEVICE_UART
			bool "Use UART"
		config AHRS_DEVICE_I2C
			bool "Use I2C"
		config AHRS_DEVICE_SPI
			bool "Use SPI"
		config AHRS_DEVICE_CAN
			bool "Use CAN"
	endchoice

	config AHRS_DEV_NUMBER
		int "AHRS Device Number"
		range 1 20
		default 9
endif

menuconfig SENSOR_MAG
	bool "Magnetic Sensor"
	default n
if SENSOR_MAG
	choice
		prompt "Select a Magnetic Sensor"
		default SENSOR_MAG_GY26

		config SENSOR_MAG_GY26
			bool "Use GY26"
		config SENSOR_MAG_QMC5883
			bool "Use QMC5883"
		config SENSOR_MAG_IST8310
			bool "Use IST8310"
	endchoice

	choice
		prompt "Select magnetic sensor Interface device type"
		default MAG_DEVICE_UART

		config MAG_DEVICE_UART
			bool "Use UART"
		config MAG_DEVICE_I2C
			bool "Use I2C"
		config MAG_DEVICE_SPI
			bool "Use SPI"
		config MAG_DEVICE_ADC
			bool "Use ADC for raw data"
	endchoice

	config MAG_DEV_NUMBER
		int "magnetic sensor Device Number"
		range 1 20
		default 10
endif

menuconfig SENSOR_CABIN_ENV
	bool "Environment Sensors in Cabin"
	default n
if SENSOR_CABIN_ENV
	config TEMPERATURE_SENSOR
		bool "Use Temperature (and Humidity) Sensor"
		default n
	if TEMPERATURE_SENSOR
		choice
			prompt "Select a Temperature (and Humidity) Sensor"
			default TEMPERATURE_SENSOR_GY39_TEMPERATURE

			config TEMPERATURE_SENSOR_GY39_TEMPERATURE
				bool "Use GY39 Board"
			config TEMPERATURE_SENSOR_SHT20
				bool "Use SHT20"
			config TEMPERATURE_SENSOR_SHT30
				bool "Use SHT30"
		endchoice

		choice
			prompt "Select Temperature Sensor Interface Device type"
			default TEMPERATURE_SENSOR_DEVICE_UART

			config TEMPERATURE_SENSOR_DEVICE_UART
				bool "Use UART"
			config TEMPERATURE_SENSOR_DEVICE_I2C
				bool "Use I2C"
			config TEMPERATURE_SENSOR_DEVICE_1_WIRE
				bool "Use 1-Wire"
			config TEMPERATURE_SENSOR_DEVICE_SPI
				bool "Use SPI"
			config TEMPERATURE_SENSOR_DEVICE_ADC
				bool "Use ADC for raw data"
		endchoice

		config TEMPERATURE_DEV_NUMBER
			int "Temperature Device Number"
			range 1 20
			default 5
	endif

	config BAROMETERS_SENSOR
		bool "Use Barometers Sensor"
		default n
	if BAROMETERS_SENSOR
		choice
			prompt "Select a Barometers Sensor"
			default BAROMETERS_SENSOR_GY39_BAROMETER
	
			config BAROMETERS_SENSOR_GY39_BAROMETER
				bool "Use GY39 Board"
			config BAROMETERS_SENSOR_BMP280
				bool "Use BMP280"
		endchoice
	
		choice
			prompt "Select Barometers Sensor Interface Device type"
			default BAROMETERS_SENSOR_DEVICE_UART
	
			config BAROMETERS_SENSOR_DEVICE_UART
				bool "Use UART"
			config BAROMETERS_SENSOR_DEVICE_I2C
				bool "Use I2C"
			config BAROMETERS_SENSOR_DEVICE_SPI
				bool "Use SPI"
			config BAROMETERS_SENSOR_DEVICE_ADC
				bool "Use ADC for raw data"
		endchoice
	
		config BAROMETERS_DEV_NUMBER
			int "Barometers Device Number"
			range 1 20
			default 6
	endif

	config ILLUMINATION_SENSOR
		bool "Use Illumination Sensor"
		default n
	if ILLUMINATION_SENSOR
		choice
			prompt "Select an Illumination Sensor"
			default ILLUMINATION_SENSOR_GY39_ILLUMINATION
	
			config ILLUMINATION_SENSOR_GY39_ILLUMINATION
				bool "Use GY39 Board"
			config ILLUMINATION_SENSOR_TEMT6000
				bool "Use TEMT6000"
			config ILLUMINATION_SENSOR_MAX44009
				bool "Use MAX44009"
		endchoice
	
		choice
			prompt "Select Illumination Sensor Interface Device type"
			default ILLUMINATION_SENSOR_DEVICE_UART
	
			config ILLUMINATION_SENSOR_DEVICE_UART
				bool "Use UART"
			config ILLUMINATION_SENSOR_DEVICE_I2C
				bool "Use I2C"
			config ILLUMINATION_SENSOR_DEVICE_SPI
				bool "Use SPI"
			config ILLUMINATION_SENSOR_DEVICE_ADC
				bool "Use ADC for raw data"
		endchoice
	
		config ILLUMINATION_DEV_NUMBER
			int "Illumination Device Number"
			range 1 20
			default 7
	endif

	config GY39_SENSOR_BOARD
		bool "Use GY39 Sensor Board"
		depends on ILLUMINATION_SENSOR_GY39_ILLUMINATION
		depends on BAROMETERS_SENSOR_GY39_BAROMETER
		depends on TEMPERATURE_SENSOR_GY39_TEMPERATURE
endif

menuconfig SENSOR_DEPTH
	bool "Water Depth Sensor"
	default n
if SENSOR_DEPTH
	choice
		prompt "Select a Water Depth Sensor"
		default SENSOR_DEPTH_MS5837

		config SENSOR_DEPTH_MS5837
			bool "Use MS5837 MEMS"
		config SENSOR_DEPTH_MS5837_SENSOR_BOARD
			bool "Use MS5837 Decoder Board"
	endchoice

	choice
		prompt "Select water depth sensor Interface device type"
		default WATER_DEPTH_DEVICE_UART

		config WATER_DEPTH_DEVICE_UART
			bool "Use UART"
		config WATER_DEPTH_DEVICE_I2C
			bool "Use I2C"
		config WATER_DEPTH_DEVICE_SPI
			bool "Use SPI"
		config WATER_DEPTH_DEVICE_ADC
			bool "Use ADC for raw data"
	endchoice

	config WATER_DEPTH_DEV_NUMBER
		int "water depth sensor Device Number"
		range 1 20
		default 11
endif

menuconfig SENSOR_SALINITY
	bool "Water Salinity Sensor"
	default n
if SENSOR_SALINITY
	choice
		prompt "Select a Water Salinity Sensor"
		default SENSOR_SALINITY_ResDet

		config SENSOR_SALINITY_ResDet
			bool "Use Resistance to measure"
		config SENSOR_SALINITY_YD301
			bool "Use YD301"
	endchoice
	
	choice
		prompt "Select salinity sensor Interface device type"
		default SALINITY_DEVICE_UART

		config SALINITY_DEVICE_UART
			bool "Use UART"
		config SALINITY_DEVICE_I2C
			bool "Use I2C"
		config SALINITY_DEVICE_CAN
			bool "Use CAN"
		config SALINITY_DEVICE_ADC
			bool "Use ADC for raw data"
	endchoice
	
	config SALINITY_DEV_NUMBER
		int "water salinity sensor Device Number"
		range 1 20
		default 12
endif

menuconfig SENSOR_SONAR
	bool "Sonar Devices and Sensors"
	default n
if SENSOR_SONAR
	choice
		prompt "Select a Sonar Device or Sensor"
		default SENSOR_SONAR_GP30

		config SENSOR_SONAR_GP30
			bool "Use GP30 Sonar"
		config SENSOR_SONAR_P360
			bool "Use P360 Sonar"
	endchoice

	choice
		prompt "Select Sonar Interface device type"
		default SONAR_DEVICE_UART

		config SONAR_DEVICE_UART
			bool "Use UART"
		config SONAR_DEVICE_I2C
			bool "Use I2C"
		config SONAR_DEVICE_CAN
			bool "Use CAN"
		config SONAR_DEVICE_PARALLEL
			bool "Use parallel interface"
		config SONAR_DEVICE_ADC
			bool "Use ADC for raw data"
	endchoice

	config SONAR_DEV_NUMBER
		int "sonar sensor Device Number"
		range 1 20
		default 13
endif

endif
```

## FinNAV/Thread/Kconfig
```kconfig
menu "Thread Component Configuration"

	choice
		prompt "Select Scheduler Object"
        default LIBROV_THREAD_NO_SCHEDULE

		config LIBROV_THREAD_MULTITIMER
			bool "Use Software MultiTimer"
		config LIBROV_THREAD_COROUTINE
			bool "Use Co-Routine"
		config LIBROV_THREAD_RTOS
			bool "Use RTOS Kernel Scheduler" 
		config LIBROV_THREAD_NO_SCHEDULE
			bool "Not Use Scheduler" 
	endchoice

	config LIBROV_USE_SOFTWARE_TIMER
		bool "Use Software Timer"
		depends on !LIBROV_THREAD_NO_SCHEDULE
		default n
endmenu
```

## build/kconfig/Kconfig
```kconfig
mainmenu "FinNAV SDK Global Configuration"

config CONFIG_TARGET_APP
	string "Target Application name"
	default "f407_finnav"

## FinNAV Toolchain Configuration ##
source "$(FINNAV_BUILD_DIR)/kconfig/Kconfig.toolchain"
## FinNAV BSP Configuration ##
source "$(FINNAV_BUILD_DIR)/kconfig/Kconfig.bsp"
## FinNAV RTOS Kernel Configuration ##
source "$(FINNAV_BUILD_DIR)/kconfig/Kconfig.rtos"

## FreeRTOS Configuration ##
source "$(FINNAV_BUILD_DIR)/kconfig/Kconfig.freertos"
## RT-Thread Configuration ##
source "$(FINNAV_BUILD_DIR)/kconfig/Kconfig.rtthread"
## LiteOS Configuration ##
# TODO LiteOS Kconfig

## FinNAV Memory&Flash Configuration ##
source "$(FINNAV_BUILD_DIR)/kconfig/Kconfig.memory"

## FinNAV LibROV Configuration ##
menuconfig CONFIG_USE_FINNAV
	bool "Use FinNAV LibROV"
	default y
if CONFIG_USE_FINNAV
	source "$(FINNAV_LIBROV_DIR)/Kconfig.main"
endif
# *** EOF ***
```

## build/kconfig/Kconfig.bsp
```kconfig
menu "FinNAV BSP Configuration"

choice
	prompt "Select target SoC family"
	default CONFIG_TARGET_SOC_FAMILY_STM32F4

	config CONFIG_TARGET_SOC_FAMILY_STM32F4
		bool "STM32F4"
	config CONFIG_TARGET_SOC_FAMILY_STM32H7
		bool "STM32H7"
	config CONFIG_TARGET_SOC_FAMILY_STM32G4
		bool "STM32G4"
endchoice

choice
	prompt "Select target Peripheral Library Standard"
	default CONFIG_TARGET_HAL_HAL
	help
		Peripheral Library Target, ensure selecting a supported Lib according to SoC

	config CONFIG_TARGET_HAL_HAL
		bool "HAL"
	config CONFIG_TARGET_HAL_STDPERIPH
		bool "STDPERIPH"
	config CONFIG_TARGET_HAL_REGISTER
		bool "REGISTER"
endchoice

config CONFIG_TARGET_SOC
    string "Select target SoC Chip"
    default "STM32F407xx"
    help
        SoC Target, ensure selecting a supported SoC

config CONFIG_TARGET_BSP
    string "Select target Borad Support Package (BSP) name"
    default "stm32f407_lite"
    help
        BSP Target, ensure selecting an existing BSP

config CONFIG_SOC_USE_FPU
    bool "Use SoC with FPU"
    default y

config CONFIG_SOC_USE_DSP
    bool "Use SoC with DSP"
    default n

config CONFIG_SOC_USE_MPU
    bool "Use SoC with MPU"
    default n

config CONFIG_SOC_USE_CACHE
	bool "Use Cache on Chip"
	default n

config CONFIG_SOC_USE_ICACHE
	bool "Use Instruction Cache"
	default n
    depends on CONFIG_SOC_USE_CACHE

config CONFIG_SOC_USE_DCACHE
	bool "Use Data Cache"
	default n
    depends on CONFIG_SOC_USE_CACHE

config CONFIG_SOC_MAIN_OSC_VALUE
    int "Main external oscillator frequency(Hz)"
    default 25000000
    range -1 50000000
    help
        High Speed External Oscillator frequency, default 25MHz

config CONFIG_SOC_INNER_OSC_VALUE
    int "Internal RC oscillator frequency(Hz)"
    default 16000000
    range -1 50000000
    help
        High Speed Internal RC oscillator frequency, default 16MHz

config CONFIG_BSP_USE_USB_OTG_FS
    bool "Use USB OTG FS"
    default n

config CONFIG_BSP_USE_USB_OTG_HS
    bool "Use USB OTG HS"
    default n

config CONFIG_BSP_USE_FATFS
    bool "Use FATFS Library"
    default n

config CONFIG_BSP_USE_LWIP
    bool "Use lwIP Library"
    default n

config CONFIG_BSP_USE_MBEDTLS
    bool "Use mbedTLS Library"
    default n

config CONFIG_BSP_USE_OPENAMP
    bool "Use OpenAMP Library"
    default n

endmenu

# *** included ***
```
